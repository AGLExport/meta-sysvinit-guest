## conf/distro/euros.conf
```bitbake
require conf/distro/poky.conf

# AGL specific derivations
DISTRO = "euros"
DISTRO_NAME = "Automotive Grade Linux Instrument Cluster"

DISTRO_VERSION = "0.0.1"
DISTRO_CODENAME = "euros-dundell"

# Override these in poky based distros
DISTRO_FEATURES := "sysvinit largefile opengl wayland alsa"
DISTRO_FEATURES_BACKFILL_CONSIDERED = "systemd gobject-introspection-data"

# Mirrors is not set
#PREMIRRORS ??= "\
#               "
#MIRRORS =+ "\
#           "

# init to use
VIRTUAL-RUNTIME_init_manager = "sysvinit"
VIRTUAL-RUNTIME_initscripts = ""

# base utils
VIRTUAL-RUNTIME_base-utils-syslog = ""

# device manager to use
PREFERRED_PROVIDER_udev = "eudev"
PREFERRED_PROVIDER_udev-utils = ""

# network manager to use
VIRTUAL-RUNTIME_net_manager = "" 

# disable console tools
PREFERRED_PROVIDER_console-tools = ""
```

## conf/layer.conf
```bitbake
# We have a conf and classes directory, add to BBPATH
BBPATH =. "${LAYERDIR}:"

# We have recipes-* directories, add to BBFILES
BBFILES += "${LAYERDIR}/recipes-*/*/*.bb \
            ${LAYERDIR}/recipes-*/*/*.bbappend"

BBFILE_COLLECTIONS += "sysvinit-guest"
BBFILE_PATTERN_sysvinit-guest = "^${LAYERDIR}/"
BBFILE_PRIORITY_sysvinit-guest = "82"
LAYERSERIES_COMPAT_sysvinit-guest = "dunfell"
```
